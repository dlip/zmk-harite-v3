## config/west.yml
```yaml
manifest:
  remotes:
    - name: zmkfirmware
      url-base: https://github.com/zmkfirmware
    - name: badjeff
      url-base: https://github.com/badjeff
    - name: dlip
      url-base: https://github.com/dlip
    - name: petejohanson
      url-base: https://github.com/petejohanson
  projects:
    - name: zmk-analog-input-driver
      remote: badjeff
      revision: 2684f22ee7e2168d4393f7e63676912210a796fc  # main
    - name: cirque-input-module
      remote: dlip
      revision: 3a32403349d52f633811db1887a46aa3a88a789d  # main
    - name: zmk-pmw3610-driver
      remote: badjeff
      revision: 44b4a76b74d293a93cec4ccb7e04cb8d29c10f93  # main
    - name: zmk
      remote: dlip
      revision: d9a926702a19ca8d7ea973e47bc74554ef94589b  # main
      import: app/west.yml
    - name: zephyr
      remote: zmkfirmware
      revision: dacab4875df72109b96cc8977547a0dc04875bcd  # v3.5.0+zmk-fixes
      import:
        name-blocklist:
          - ci-tools
          - hal_altera
          - hal_cypress
          - hal_infineon
          - hal_microchip
          - hal_nxp
          - hal_openisa
          - hal_silabs
          - hal_xtensa
          - hal_st
          - hal_ti
          - loramac-node
          - mcuboot
          - mcumgr
          - net-tools
          - openthread
          - edtt
          - trusted-firmware-m
  self:
    path: config
```
